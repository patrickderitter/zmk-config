## config/west.yml
```yaml
manifest:
  remotes:
    - name: zmkfirmware
      url-base: https://github.com/zmkfirmware
    - name: boardsource
      url-base: https://github.com/tmcarr
  projects:
    - name: zmk
      remote: zmkfirmware
      revision: main
      import: app/west.yml
    - name: Rechtek-zmk-config
      remote: boardsource
      revision: migrate-to-hwmv2
  self:
    path: config
```
